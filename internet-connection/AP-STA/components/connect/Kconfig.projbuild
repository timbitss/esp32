## internet-connection/AP-STA/components/connect/Kconfig.projbuild
```kconfig
menu "ESP32 as soft AP credentials"

config ESP32AP_SSID
    string "ESP32 as soft-AP SSID"
    default "xxxxx"

config ESP32AP_PWD
    string "ESP32 as soft-AP password"
    default "xxxxx"  

endmenu
```

## internet-connection/REST-Client/components/rest/Kconfig.projbuild
```kconfig
menu "Twilio Configurations"

config TWILIO_SID
    string "Twilio SID"
    default "xxxx"

config TWILIO_AUTH_TOKEN
    string "Twilio authentification token"
    default "xxxx"  

config FROM_PHONE_NUM
    string "Twilio phone number"
    default "+10000000000"

config TO_PHONE_NUM
    string "Phone number to send message to"
    default "+10000000000"

endmenu
```
